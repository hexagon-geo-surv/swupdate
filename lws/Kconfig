## lws/Kconfig
```kconfig
# SPDX-FileCopyrightText: 2026 Bastian Germann
#
# SPDX-License-Identifier: GPL-2.0-only

config LWS
	bool "libwebsockets"
	depends on HAVE_LIBWEBSOCKETS
	help
	  Enable a webserver built on libwebsockets.

	  Endpoints:
	    POST /upload  - upload a SWU image
	                    (multipart/form-data or application/octet-stream)
	    POST /restart - trigger the post-update action
	    GET  *        - static file serving from a configurable web root
	                    (set via -r or the web-root config option)
	    GET  (ws)     - WebSocket status stream
	                    (same JSON protocol as the mongoose webserver)
```

## mongoose/Kconfig
```kconfig
# SPDX-FileCopyrightText: 2013 Stefano Babic <stefano.babic@swupdate.org>
#
# SPDX-License-Identifier: GPL-2.0-only

config MONGOOSE
	bool "mongoose"
	help
	  Mongoose embeddded web server
```
